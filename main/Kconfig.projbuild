## main/Kconfig.projbuild
```kconfig
menu "Makera Z1 test hardware"

config Z1_MOCK_ALL_HARDWARE
    bool "Use mock adapters for all supported hardware"
    default n
    help
        Select every mock hardware adapter implemented by this firmware.
        This is a test-build option and must remain disabled in production.

config Z1_MOCK_SD_HARDWARE
    bool "Use a PSRAM-backed mock SD card"
    default n
    help
        Mount a volatile FAT filesystem at /sd instead of using SDMMC.

config Z1_MOCK_CAMERA_HARDWARE
    bool "Use a deterministic mock camera"
    default n
    help
        Provide deterministic JPEG frames without probing a physical camera.

config Z1_MOCK_CONTROLLER_HARDWARE
    bool "Use a deterministic mock controller UART"
    default n
    help
        Simulate framed controller status, diagnostic, and version traffic.

config Z1_MOCK_NVS_HARDWARE
    bool "Allow deterministic NVS boundary failures"
    default n
    help
        Permit test commands to fail namespace-open or commit operations.
        Persistent values still use the real NVS partition.

config Z1_MOCK_NETWORK_HARDWARE
    bool "Allow deterministic socket boundary failures"
    default n
    help
        Permit one-shot discovery-open, discovery-send, and TCP-send failures.
        Live Wi-Fi and lwIP sockets remain active around the injected boundary.

config Z1_MOCK_SD_CAPACITY_KIB
    int "Mock SD capacity in KiB"
    depends on Z1_MOCK_ALL_HARDWARE || Z1_MOCK_SD_HARDWARE
    range 256 4096
    default 512

config Z1_MOCK_SD_MIN_FREE_PSRAM_KIB
    int "PSRAM reserve after mock SD allocation in KiB"
    depends on Z1_MOCK_ALL_HARDWARE || Z1_MOCK_SD_HARDWARE
    range 256 4096
    default 512

endmenu
```

## sdkconfig.defaults
```kconfig
# Target, flash, and memory defaults required by HW-001 through HW-006.
CONFIG_IDF_TARGET="esp32s3"
CONFIG_ESPTOOLPY_FLASHSIZE_16MB=y
CONFIG_ESPTOOLPY_FLASHMODE_DIO=y
CONFIG_ESPTOOLPY_FLASHFREQ_80M=y
CONFIG_PARTITION_TABLE_CUSTOM=y
CONFIG_PARTITION_TABLE_CUSTOM_FILENAME="partitions.csv"
CONFIG_ESP_DEFAULT_CPU_FREQ_MHZ_160=y
CONFIG_ESP_DEFAULT_CPU_FREQ_MHZ=160
CONFIG_SPIRAM=y
CONFIG_SPIRAM_MODE_OCT=y
CONFIG_SPIRAM_SPEED_80M=y
CONFIG_SPIRAM_MEMTEST=y
CONFIG_SECURE_BOOT=n
CONFIG_SECURE_FLASH_ENC_ENABLED=n
CONFIG_NVS_ENCRYPTION=n
CONFIG_ESP_COREDUMP_ENABLE_TO_NONE=y
CONFIG_ESP_INT_WDT=y
CONFIG_ESP_INT_WDT_TIMEOUT_MS=300
CONFIG_ESP_TASK_WDT_EN=y
CONFIG_ESP_TASK_WDT_TIMEOUT_S=5
CONFIG_ESP_TASK_WDT_PANIC=n
CONFIG_ESP_BROWNOUT_DET=y
CONFIG_ESP_BROWNOUT_DET_LVL_SEL_7=y
CONFIG_BOOTLOADER_WDT_TIME_MS=9000
CONFIG_BOOTLOADER_APP_ROLLBACK_ENABLE=y
CONFIG_FATFS_CODEPAGE_437=y
CONFIG_FATFS_LFN_NONE=y
CONFIG_FATFS_SECTOR_4096=y
CONFIG_FATFS_FS_LOCK=16
CONFIG_FATFS_TIMEOUT_MS=10000
CONFIG_LOG_DEFAULT_LEVEL_INFO=y
CONFIG_LOG_MAXIMUM_LEVEL=3
CONFIG_LWIP_MAX_SOCKETS=16
CONFIG_LWIP_LOCAL_HOSTNAME="espressif"
CONFIG_LWIP_TCP_QUEUE_OOSEQ=y
CONFIG_LWIP_TCP_SACK_OUT=y
CONFIG_HTTPD_MAX_REQ_HDR_LEN=512
CONFIG_HTTPD_MAX_URI_LEN=512
CONFIG_HTTPD_WS_SUPPORT=y
CONFIG_SPIFFS_PAGE_SIZE=256
CONFIG_SPIFFS_OBJ_NAME_LEN=64
CONFIG_SPIFFS_USE_MAGIC=y
CONFIG_SPIFFS_USE_MAGIC_LENGTH=y
CONFIG_SPIFFS_META_LENGTH=4
CONFIG_SPIFFS_USE_MTIME=y
CONFIG_BT_ENABLED=y
CONFIG_BT_BLUEDROID_ENABLED=y
CONFIG_BT_BLE_ENABLED=y
CONFIG_BT_BLE_BLUFI_ENABLE=y
CONFIG_BT_CLASSIC_ENABLED=n
CONFIG_BT_GATTC_ENABLE=n
CONFIG_BT_BLE_SMP_ENABLE=n
CONFIG_BT_SMP_ENABLE=n
CONFIG_BT_BLE_42_FEATURES_SUPPORTED=y
CONFIG_BT_BLE_50_FEATURES_SUPPORTED=n
CONFIG_MBEDTLS_DHM_C=y
CONFIG_TINYUSB_VENDOR_COUNT=1
CONFIG_ESP_SYSTEM_EVENT_TASK_STACK_SIZE=4096
```
